/*
 * Product: Himax on QUP0 SE4 FIFO (no GPI DMA). Do not bind GPIO100.
 * Per-SE IRAM + skip-wrapper, never wrapper CSR. Failure: restore-a.
 */
&himax_spi { status = "disabled"; };

&gpi_dma0 { status = "disabled"; };

&spi4 {
	/delete-property/ interconnects;
	/delete-property/ interconnect-names;
	/delete-property/ dmas;
	/delete-property/ dma-names;
	firmware-name = "qcom/sm8250/xiaomi/dagu/qupv3fw.elf";
	qcom,skip-wrapper-fw-init;
	pinctrl-names = "default";
	pinctrl-0 = <&himax_spi_qup_default>;
	spi-max-frequency = <4000000>;
	status = "okay";

	himax_ts_geni: touchscreen@0 {
		compatible = "himax,hx83121-dagu", "himax,hxcommon";
		reg = <0>;
		spi-max-frequency = <4000000>;
		spi-cpol;
		spi-cpha;
		pinctrl-names = "default";
		pinctrl-0 = <&himax_irq_default>;
		interrupt-parent = <&tlmm>;
		interrupts = <39 IRQ_TYPE_LEVEL_LOW>;
		touchscreen-size-x = <1600>;
		touchscreen-size-y = <2560>;
		himax,display-coords = <0 1600 0 2560>;
		/* GPIO100 is panel tp-reset; do not bind it here. */
	};
};
